/**
 * @ingroup hwExamples
 * @{
 *
 * @file example_timer_interrupt.c
 * @brief Uses the microcontroller's internal oscillator to configure a timer to wake up periodically.
 * Toggles LED0 when an interrupt is generated from the timer. Otherwise sleeps.
 *
 * $Rev: 1770 $
 * $Author: dsmith $
 * $Date: 2013-03-07 14:55:49 -0800 (Thu, 07 Mar 2013) $
 *
 * @section support Support
 * Please refer to the wiki at www.anaren.com/air-wiki-zigbee for more information. Additional support
 * is available via email at the following addresses:
 * - Questions on how to use the product: AIR@anaren.com
 * - Feature requests, comments, and improvements:  featurerequests@teslacontrols.com
 * - Consulting engagements: sales@teslacontrols.com
 *
 * @section license License
 * Copyright (c) 2012 Tesla Controls. All rights reserved. This Software may only be used with an 
 * Anaren A2530E24AZ1, A2530E24CZ1, A2530R24AZ1, or A2530R24CZ1 module. Redistribution and use in 
 * source and binary forms, with or without modification, are subject to the Software License 
 * Agreement in the file "anaren_eula.txt"
 * 
 * YOU FURTHER ACKNOWLEDGE AND AGREE THAT THE SOFTWARE AND DOCUMENTATION ARE PROVIDED “AS IS” 
 * WITHOUT WARRANTY OF ANY KIND, EITHER EXPRESS OR IMPLIED, INCLUDING WITHOUT LIMITATION, ANY 
 * WARRANTY OF MERCHANTABILITY, TITLE, NON-INFRINGEMENT AND FITNESS FOR A PARTICULAR PURPOSE. IN NO 
 * EVENT SHALL ANAREN MICROWAVE OR TESLA CONTROLS BE LIABLE OR OBLIGATED UNDER CONTRACT, NEGLIGENCE, 
 * STRICT LIABILITY, CONTRIBUTION, BREACH OF WARRANTY, OR OTHER LEGAL EQUITABLE THEORY ANY DIRECT OR 
 * INDIRECT DAMAGES OR EXPENSE INCLUDING BUT NOT LIMITED TO ANY INCIDENTAL, SPECIAL, INDIRECT, 
 * PUNITIVE OR CONSEQUENTIAL DAMAGES, LOST PROFITS OR LOST DATA, COST OF PROCUREMENT OF SUBSTITUTE 
 * GOODS, TECHNOLOGY, SERVICES, OR ANY CLAIMS BY THIRD PARTIES (INCLUDING BUT NOT LIMITED TO ANY 
 * DEFENSE THEREOF), OR OTHER SIMILAR COSTS.
 */

#include "../HAL/hal.h"
#include <stdint.h>

/** function pointer (in hal file) for the function that gets called when the timer generates an int*/
extern void (*timerIsr)(void);

/** Handles timer interrupt */
void handleTimer();

int main( void )
{
    halInit();
    printf("Timer Interrupt Example\r\n");

    /** Calibrate the Very Low Power Oscillator, since this will clock the timer */
    uint16_t vlo = calibrateVlo();
    printf("Very Low Oscillator (VLO) = %u Hz\r\n", vlo);
    clearLeds();
    timerIsr = &handleTimer;
    HAL_ENABLE_INTERRUPTS();

    /** Initialize the timer to generate an interrupt every 2 seconds */
    int16_t timerResult = initTimer(2);
    if (timerResult != 0)
    {
        printf("timerResult Error %i, STOPPING\r\n", timerResult);
        while (1);
    }

    while (1)
    {
        /* if we get woken up, just display a message and then go back to sleep */
        HAL_SLEEP();
        printf("Timer Interrupt\r\n");
        while (halUartBusy());				// wait until the UART is done transmitting before sleeping
    }
}

/** Timer interrupt service routine. Called when interrupt generated by the timer.
@pre global interrupts have been enabled
@pre timerIsr function pointer has been pointed to this function, e.g.
<pre>
timerIsr = &handleTimer;
</pre>
@pre Timer has been configured with initTimer()
 */
void handleTimer()
{
    toggleLed(0);
    delayMs(100);
    toggleLed(0);
}


/* @} */
